## arch/arm/mach-msm/xiaomi/Kconfig
```kconfig
config MACH_XIAOMI
	bool

menu "Xiaomi Board Selection"
source "arch/arm/mach-msm/xiaomi/Kconfig.board"
endmenu


menu "Xiaomi Specific Patches"

config XIAOMI_EARJACK_UART
	bool "Earjack UART"
	default n
	depends on MACH_XIAOMI
	help
	  Enable Earjack UART debugger. This disables headphone support

config XIAOMI_KEXEC_HARDBOOT_SYSNODE
	bool "kexec hardboot sys node"
	default n
	depends on KEXEC
	depends on KEXEC_HARDBOOT
	help
	  Interface to Show kexec hardboot address

endmenu
```
